## CMakeLists.txt
```
cmake_minimum_required(VERSION 3.20.0)

# Use JTAG for flashing/debugging (no serial port needed)
set(BOARD_FLASH_RUNNER openocd CACHE STRING "" FORCE)
set(BOARD_DEBUG_RUNNER openocd CACHE STRING "" FORCE)

# Force the board + toolchain (overrides any cached value)
set(BOARD "esp32s3_devkitm/esp32s3/procpu" CACHE STRING "Zephyr board target" FORCE)
set(ZEPHYR_TOOLCHAIN_VARIANT "espressif" CACHE STRING "Zephyr toolchain" FORCE)

# Make CMake/FindPython3 use your Zephyr venv Python (not ESP-IDF’s)
set(Python3_EXECUTABLE "$ENV{HOME}/proj/zephyr/zephyr-env/.zephyr-venv/bin/python3"
    CACHE FILEPATH "Python 3 interpreter" FORCE)

# Locate Zephyr
if(NOT DEFINED ZEPHYR_BASE)
  if(DEFINED ENV{ZEPHYR_BASE})
    set(ZEPHYR_BASE $ENV{ZEPHYR_BASE})
  else()
    message(FATAL_ERROR "ZEPHYR_BASE not set. Source your zephyr_env.sh first.")
  endif()
endif()
find_package(Zephyr REQUIRED HINTS ${ZEPHYR_BASE})

project(hello_cmake)
target_sources(app PRIVATE src/main.c)

# --- Debug flags ---
# Force debug info even if the default is Release/RelWithDebInfo
set(CMAKE_BUILD_TYPE Debug CACHE STRING "Build type" FORCE)

# Override C flags for debug builds (keep some optimization for stepping)
set(CMAKE_C_FLAGS_DEBUG "-Og -g3" CACHE STRING "" FORCE)
set(CMAKE_CXX_FLAGS_DEBUG "-Og -g3" CACHE STRING "" FORCE)

# Force unstripped binaries
set(CMAKE_STRIP "" CACHE STRING "" FORCE)

# sometimes espressif does not like dwarf5
set(CMAKE_C_FLAGS_DEBUG "-Og -g3 -gdwarf-4" CACHE STRING "" FORCE)
```

## prj.conf
```kconfig
CONFIG_BUILD_OUTPUT_HEX=y

# Make the artifacts we need for OpenOCD JTAG flashing
CONFIG_BUILD_OUTPUT_BIN=y         # keep HEX too if you want: CONFIG_BUILD_OUTPUT_HEX=y


# Use UART0 instead of USB CDC for console
CONFIG_UART_CONSOLE=y
#CONFIG_USB_DEVICE_STACK=n
#CONFIG_SERIAL=y
#CONFIG_CONSOLE=y
#CONFIG_RTT_CONSOLE=n

CONFIG_LTO=n
```

## src/main.c
```c
/*
 * Copyright (c) 2012-2014 Wind River Systems, Inc.
 *
 * SPDX-License-Identifier: Apache-2.0
 */

#include <stdio.h>
#include <zephyr/kernel.h>

int main(void)
{
	 while (1) {
        printk("Hello, World!\n");
        k_sleep(K_SECONDS(1));
    }

	return 0;
}
```
